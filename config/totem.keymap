/*
 * totem.keymap — Colemak + Hands Down Promethium on a TOTEM
 *
 * SPDX-License-Identifier: MIT
 *
 * Ported from the QMK userspace at ~/code/perso/keyboard/qmk_userspace
 * (users/raphaelmor), which remains the spec source of truth: TouchTutor parses
 * those C files, and `tt verify` needs the QMK HID console that ZMK has no
 * equivalent of. Keep the two in sync by hand, and prefer matching the QMK
 * behaviour over adopting a nicer ZMK idiom.
 *
 * STRUCTURE (mirrors moutis' own ZMK config, config/corneish_zen.keymap)
 *   keynames_totem.h        38 key position names, shared with QMK and moutis
 *   ramo/ramo_config.dtsi   layer indices, timings, stock-behaviour overrides
 *   layouts/hdp-config.h    the Hands Down Promethium base
 *   layouts/hdp-adapt.dtsi  its 20 adaptive rules + CommaMagic
 *   layouts/cmk-config.h    the Colemak base
 *   layouts/layers_def.h    the six non-alpha layers
 *   ramo/ramo_behaviors.dtsi hold-taps, mod-morphs, linger keys, tap dances
 *   ramo/ramo_macros.dtsi   digraph and bracket-pair macros
 *   ramo/ramo_combos.dtsi   19 combos (18 ported from QMK, 1 for base recovery)
 *   keymap_totem.dtsi       the 8 layer blocks
 *
 * BASE LAYERS
 *   Colemak is layer 0 and Hands Down is layer 1, matching the QMK enum order in
 *   ramo_layers.h. ZMK's layer 0 is special — it can never be deactivated and the
 *   default layer is permanently 0 — so Colemak has to take it, and the board
 *   comes up in Colemak after a reboot or a deep-sleep wake.
 *
 *   To get to Hands Down: press both outer pinky keys together (LB5+RB5), or
 *   double-tap the HDP key on NAV. CONFIG_ZMK_IDLE_SLEEP_TIMEOUT in totem.conf
 *   keeps reboots infrequent.
 *
 * RECOVERY, carried over from the matrix validation keymap this replaced
 *   Press the XIAO reset button twice, quickly. The board mounts as a USB drive;
 *   drag a .uf2 onto it. This works whatever the firmware does, and is the
 *   reliable path — &rst_btld on MED is only a convenience.
 *
 *   If nothing types at all over USB, suspect the output endpoint before the
 *   matrix: ZMK stores the USB-or-Bluetooth choice in the settings partition and a
 *   .uf2 update does not erase it. Hold the left Esc thumb for MED, then press the
 *   outer top-right key to force USB, or the key left of it to clear stale
 *   Bluetooth bonds. Both work locally without working HID output.
 *
 *   The full 38-switch validation keymap, with its per-symptom diagnosis table, is
 *   in git history at commit ce1d533 if a matrix fault ever needs chasing again.
 */

#include <behaviors.dtsi>
#include <dt-bindings/zmk/keys.h>
#include <dt-bindings/zmk/modifiers.h>
#include <dt-bindings/zmk/bt.h>
#include <dt-bindings/zmk/outputs.h>

/*
 * Mouse speed, ported from QMK's MOUSEKEY_MAX_SPEED 6 at MOUSEKEY_INTERVAL 16
 * (users/raphaelmor/config.h:17-26): 6 units per 16 ms is 375 units per second,
 * and ZMK counts per second. The rest of the tuning is on &mmv in ramo_config.dtsi.
 *
 * These MUST come before the include — pointing.h guards both with #ifndef, so a
 * define afterwards is silently ignored. Nothing in behaviors.dtsi pulls pointing.h
 * in first, which is what makes this ordering work.
 */
#define ZMK_POINTING_DEFAULT_MOVE_VAL 375
#define ZMK_POINTING_DEFAULT_SCRL_VAL 10
#include <dt-bindings/zmk/pointing.h>

#include "keynames_totem.h"
#include "ramo/ramo_config.dtsi"

#include "layouts/hdp-config.h"
#include "layouts/cmk-config.h"
#include "layouts/layers_def.h"

/ {
/*
 * Behaviors. Forward references to the macros below are fine: devicetree resolves
 * phandles after the whole tree is parsed.
 */
    behaviors {

#include "ramo/ramo_behaviors.dtsi"
#include "layouts/hdp-adapt.dtsi"

    };

    macros {

#include "ramo/ramo_macros.dtsi"

    };

    combos {
        compatible = "zmk,combos";

#include "ramo/ramo_combos.dtsi"

    };

#include "keymap_totem.dtsi"

};
